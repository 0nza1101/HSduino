#include <Adafruit_GFX.h>    // Core graphics library
//#include <./Fonts/FreeSerif9pt7b.h>
#include <Adafruit_TFTLCD.h> // Hardware-specific library
#include <TouchScreen.h>

#define LCD_CS A3 
#define LCD_CD A2
#define LCD_WR A1
#define LCD_RD A0
#define LCD_RESET A4

#define YP A1
#define XM A2 
#define YM 7  
#define XP 6   

#define TS_MINX 150
#define TS_MINY 120
#define TS_MAXX 920
#define TS_MAXY 940

#define MINPRESSURE 0
#define MAXPRESSURE 1000

TouchScreen ts = TouchScreen(XP, YP, XM, YM, 300);
Adafruit_TFTLCD tft(LCD_CS, LCD_CD, LCD_WR, LCD_RD, LCD_RESET);

#define BLACK   0x0000
#define RED     0xF800
#define GREEN   0x07E0
#define WHITE   0xFFFF

#define GAME_VER   "         1.0"

/*GAME VARIABLES*/
boolean isPlaying = false;
short maxScore = 0;
unsigned int score = 0;

static const unsigned char PROGMEM TERRORIST[]{
0x0,0x0,0x0,0x0,0x0,0x0,0x0,0x0,0x0,0xf,0xf8,0x0,0x0,0x0,0x0,0x0,0x0,0x0,0x0,
0x0,0x0,0x0,0x0,0x0,0x0,0x0,0x0,0x0,0x0,0xff,0xf0,0x0,0x0,0x0,0x0,0x0,0x0,0x0,
0x0,0x0,0x0,0x0,0x0,0x0,0x0,0x0,0x0,0x0,0x7f,0xfc,0x0,0x0,0x0,0x0,0x0,0x0,0x0,
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0x0,0x0,0x0,0x0,0x0,0x0,0x0,0x0,0x0,0xff,0xff,0xff,0xff,0xff,0xff,0xff,0xff,0xff,0xfc
};

static const unsigned char PROGMEM HEAD[]{
  0x0,0x0,0x0,0x7f,0xfe,0x0,0x0,0x0,0x0,
0x0,0x0,0xf,0xff,0xff,0x80,0x0,0x0,0x0,
0x0,0x0,0x2,0x7f,0xff,0xe0,0x0,0x0,0x0,
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0x0,0x0,0x0,0x0,0x0,0x0,0x0,0x0,0x0
};

void setup() {
   tft.reset();
   uint16_t identifier = tft.readID();
   tft.begin(identifier);
   tft.setRotation(2);
   tft.fillScreen(BLACK);
  // tft.setFont(&FreeSerif9pt7b);
  Serial.begin(9600);

}

void loop() {
  mainMenu();
}

void mainMenu(void){ 
  tft.drawBitmap(40, 155, TERRORIST, 150, 147, WHITE);
  tft.setTextSize(2);
  tft.setTextColor(WHITE);
  tft.setCursor(40, 40);
  tft.print("CS:GO HSduino\n");tft.print(GAME_VER);//Title  

  tft.setTextColor(WHITE);
  tft.drawRect(40, 100, 155, 50, WHITE);//Play
  tft.setCursor(90, 120);
  tft.print("Play");
  
  /*tft.drawRect(40, 190, 155, 50, WHITE);//About
  tft.setCursor(90, 210);
  tft.print("About");*/

  tft.setCursor(35, tft.height()-10);
  tft.setTextSize(1);
  tft.print("DoneGames Open Source project");
  
  //Touch screen declaration
  TSPoint p = ts.getPoint();
  digitalWrite(13, HIGH);
  digitalWrite(13, LOW);
  pinMode(XM, OUTPUT);
  pinMode(YP, OUTPUT);
  
  if (p.z > MINPRESSURE && p.z < MAXPRESSURE) 
  {
    p.x = tft.width()-(map(p.x, TS_MINX, TS_MAXX, tft.width(), 0));
    p.y = tft.height()-(map(p.y, TS_MINY, TS_MAXY, tft.height(), 0));
    //Touch screen detection
    if (p.x < 140){
      if( p.y  > 140) {
        play();
      }
    }
  }
}

void play(){
  tft.fillScreen(BLACK);//Clear screen
  tft.setRotation(3);
  isPlaying = true;
  score = 0;//Reset score

  while(isPlaying){
    drawScore();
    drawHead(random(0, 320-20), random(0, 240-20));
  }
}

void drawScore(){
  tft.setCursor(1, 0);
  tft.setTextSize(2);
  tft.fillRect(0, 0, 50, 20, BLACK);
  tft.print(score);
  tft.print(" Headshots");
  delay(100);
}

void drawHead(int x, int y){
  unsigned long showtime;
  boolean showed = false;

  TSPoint p = ts.getPoint();
  digitalWrite(13, HIGH);
  digitalWrite(13, LOW);
  pinMode(XM, OUTPUT);
  pinMode(YP, OUTPUT);
  
    //Difficulty changer
  if(score >= 0 && score<= 5)
    showtime = 8000;//8s
  else if(score >= 6 && score<= 10)
    showtime = 6000;//6s
  else if(score >= 11 && score<= 20)
    showtime = 4000;//4s
  else if(score < 20)
    showtime = 500;//2s

  //Draw logic
  tft.fillRoundRect(x, y, 65, 84, 5, BLACK); 
  tft.drawBitmap(x, y, HEAD, 65, 87, WHITE);
  showed = true;
  delay(200);

  //if image shown but not pressed
  if(showed == true){
    delay(showtime);
    tft.fillRoundRect(x, y, 65, 84, 5, BLACK);
    gameover();   
   }
   //if image shown but pressed 
   else if(showed == true && (p.z > MINPRESSURE && p.z < MAXPRESSURE)){
    p.x = tft.width()-(map(p.x, TS_MINX, TS_MAXX, tft.width(), 0));
    p.y = tft.height()-(map(p.y, TS_MINY, TS_MAXY, tft.height(), 0));
    Serial.println("Head X positiion :");
    Serial.println(x);
    Serial.println("Head Y positiion :");
    Serial.println(y);
    Serial.println("Touched X positiion :");
    Serial.println(p.x);
    Serial.println("Touched Y positiion :");
    Serial.println(p.y);
    if((p.x >= x-20) && (p.x <= x+20)){
      if((p.y >= y-20)&&(p.y <= y+20)){
         tft.fillRoundRect(x, y, 320, 240, 5, BLACK);
         score++;
         showed = false;
      }
    }
   }
}

void gameover(){
  unsigned short timer = 6;
  tft.fillScreen(BLACK);
  tft.setCursor(120, 10);
  tft.setTextSize(2);

  tft.print("GAMEOVER");
  tft.setCursor(40, 60);
  tft.print("Game restart in ");
  
  tft.print("5sec");

  tft.setCursor(120, 80);
  tft.print("Score : ");
  tft.print(score);
  delay(5000);
  
  tft.fillScreen(BLACK);
}

